## drivers/gpu/drm/lima/Kconfig
```kconfig
# SPDX-License-Identifier: GPL-2.0 OR MIT
# Copyright 2017-2019 Qiang Yu <yuq825@gmail.com>

config DRM_LIMA
       tristate "LIMA (DRM support for ARM Mali 400/450 GPU)"
       depends on DRM
       depends on ARM || ARM64 || COMPILE_TEST
       depends on MMU
       depends on COMMON_CLK
       depends on OF
       select DRM_SCHED
       select DRM_GEM_SHMEM_HELPER
       select PM_DEVFREQ
       select DEVFREQ_GOV_SIMPLE_ONDEMAND
       help
	 DRM driver for ARM Mali 400/450 GPUs.

config DRM_LIMA_OF_ID_PREFIX
       string "Device Tree ID prefix"
       default "arm,mali-"
       depends on DRM_LIMA
       help
	 ID prefix specified in the compatible property of the device tree.

config DRM_LIMA_OF_ID_PARAMETERIZE
       bool "Parameterize Device Tree ID"
       default n
       depends on DRM_LIMA
       help
	 Parameterize the device ID of Lima so that it can be changed at boot time.
	 For example, specify lima.of_400_id=arm,mali-400 as a boot paramater.
```

## drivers/gpu/drm/xlnx/Kconfig
```kconfig
config DRM_ZYNQMP_DPSUB
	tristate "ZynqMP DisplayPort Controller Driver"
	depends on ARCH_ZYNQMP || COMPILE_TEST
	depends on COMMON_CLK && DRM && OF
	depends on DMADEVICES
	select XILINX_DMA_ENGINES
	select PHY_XILINX_ZYNQMP
	select XILINX_ZYNQMP_DPDMA
	help
	  This is a DRM/KMS driver for ZynqMP DisplayPort controller. Choose
	  this option if you have a Xilinx ZynqMP SoC with DisplayPort
	  subsystem.

config DRM_XLNX
	tristate "Xilinx DRM KMS Driver"
	depends on DRM && OF
	select DRM_KMS_HELPER
	select DRM_KMS_CMA_HELPER
	help
	  Xilinx DRM KMS driver. Choose this option if you have
	  a Xilinx SoCs with hardened display pipeline or soft
	  display pipeline using Xilinx IPs in FPGA. This module
	  provides the kernel mode setting functionalities
	  for Xilinx display drivers.

config DRM_XLNX_DUMB_ALIGNMENT_DEFAULT_SIZE
	int "Xilinx DRM Dumb Buffer Alignment Default Size"
	range 0 4096
	default 0
	depends on DRM_XLNX
	help
	  This specifies the default value for dumb buffer alignment size 
	  of the Xilinx DRM Driver. The dumb buffer alignment size can 
	  also be set in the module parameter. If not set by module 
	  parameter, this value will be set to dumb buffer alignment size.
	  If 0 is specified for the dumb buffer alignment size, Xilinx 
	  DRM forces the alignment size to 256, which is the ZYNQMP_DPDMA 
	  alignment size. When used with the Lima DRM driver, the dumb 
	  buffer alignment size must be set to 8.

config DRM_XLNX_DUMB_CACHE_DEFAULT_MODE
	int "Xilinx DRM Dumb Buffer Cache Default Mode"
	range 0 1
	default 0
	depends on DRM_XLNX
	help
	  Thie specifies the data cache state of dumb buffer of the
	  Xilinx DRM Driver. The dumb buffer data cache mode can also
	  bo set in the module parameter. If not set by module parameter,
	  this value will be set to dumb buffer data cache state.
	  If 0 is specified, the dumb buffer data cache mode is set to
	  write combine and read cache off.
	  If 1 is specified, the dumb buffer data cache mode is set to
	  write back and read cache on.
	  
config DRM_XLNX_BRIDGE
	tristate "Xilinx DRM KMS bridge"
	depends on DRM_XLNX
	help
	  Xilinx DRM KMS bridge. This module provides some interfaces
	  to enable inter-module communication. Choose this option
	  from the provider driver when the Xilinx bridge interface is
	  needed.

config DRM_XLNX_BRIDGE_DEBUG_FS
	bool "Xilinx DRM KMS bridge debugfs"
	depends on DEBUG_FS && DRM_XLNX_BRIDGE
	help
	  Enable the debugfs code for Xilinx bridge. The debugfs code
	  enables debugging or testing related features. It exposes some
	  low level controls to the user space to help testing automation,
	  as well as can enable additional diagnostic or statistical
	  information.

config DRM_XLNX_DPTX
	tristate "Xilinx DRM DisplayPort Subsystem Driver"
	depends on DRM_XLNX
	help
	  DRM driver for Xilinx DisplayPort Tx Subsystem for FPGA. Choose
	  this option if you have a FPGA display pipeline that includes
	  the Xilinx DisplayPort Tx Subsystem IP. The driver provides
	  the kernel mode setting functionalities for the IP.

config DRM_XLNX_DSI
	tristate "Xilinx DRM DSI Subsystem Driver"
	depends on DRM_XLNX
	select DRM_MIPI_DSI
	select DRM_PANEL
	select BACKLIGHT_LCD_SUPPORT
	select BACKLIGHT_CLASS_DEVICE
	select DRM_PANEL_SIMPLE
	help
	  DRM driver for Xilinx MIPI-DSI.

config DRM_XLNX_HDMITX
	tristate "Xilinx DRM HDMI Subsystem Driver"
	depends on DRM_XLNX
	help
	  DRM driver for Xilinx HDMI Tx Subsystem for FPGA. Choose
	  this option if you have a FPGA display pipeline that includes
	  the Xilinx HDMI Tx Subsystem IP. The driver provides
	  the kernel mode setting functionalities for the IP.

config DRM_XLNX_MIXER
	tristate "Xilinx DRM Mixer Driver"
	depends on DRM_XLNX
	select VIDEOMODE_HELPERS
	help
	  DRM driver for Xilinx Mixer driver.

config DRM_XLNX_PL_DISP
	tristate "Xilinx DRM PL display driver"
	depends on DRM_XLNX
	select VIDEOMODE_HELPERS
	help
	  DRM driver for Xilinx PL display driver, provides drm
	  crtc and plane object to display pipeline. You need to
	  choose this option if your display pipeline needs one
	  crtc and plane object with single DMA connected.

config DRM_XLNX_SDI
	tristate "Xilinx DRM SDI Subsystem Driver"
	depends on DRM_XLNX
	help
	  DRM driver for Xilinx SDI Tx Subsystem.

config DRM_XLNX_BRIDGE_CSC
	tristate "Xilinx DRM CSC Driver"
	depends on DRM_XLNX_BRIDGE
	help
	  DRM brige driver for color space converter of VPSS. Choose
	  this option if color space converter is connected to an encoder.
	  The driver provides set/get resolution and color format
	  functionality through bridge layer.

config DRM_XLNX_BRIDGE_SCALER
	tristate "Xilinx DRM Scaler Driver"
	depends on DRM_XLNX_BRIDGE
	help
	  DRM brige driver for scaler of VPSS. Choose this option
	  if scaler is connected to an encoder. The driver provides
	  upscaling, down scaling and no scaling functionality through
	  bridge layer.

config DRM_XLNX_BRIDGE_VTC
	tristate "Xilinx DRM VTC Driver"
	depends on DRM_XLNX_BRIDGE
	help
	  DRM brige driver for Xilinx Video Timing Controller. Choose
	  this option to make VTC a part of the CRTC in display pipeline.
	  Currently the support is added to the Xilinx Video Mixer and
	  Xilinx PL display CRTC drivers. This driver provides ability
	  to generate timings through the bridge layer.
```
